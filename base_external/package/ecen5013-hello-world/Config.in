## base_external/package/ecen5013-hello-world/Config.in
```kconfig
# Credit goes to the University of Colorado - Boulder Coursera Edition
# URL: https://github.com/cu-ecen-aeld/buildroot-external/blob/ecen5013-hello-world/base_external/package/ecen5013-hello-world/Config.in
#####

config BR2_PACKAGE_ECEN5013_HELLO_WORLD
	bool "ecen5823-hello-world"
	help
	  Hello world example for ECEN5013, used to introduce
	  Buildroot external trees and package builds.
```
